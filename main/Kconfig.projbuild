## main/Kconfig.projbuild
```kconfig
# -----------------------------------------------------------------------------------
# Copyright 2024, Gilles Zunino
# -----------------------------------------------------------------------------------

menu "Holiday Tree"

    choice HOLIDAYTREE_HARDWARE
        prompt "Hardware type"
        default HOLIDAYTREE_HARDWARE_DEVELOPMENT
        help
            Select the type of hardware to compile for

        config HOLIDAYTREE_HARDWARE_PRODUCTION
            bool "SmartButton"
            help
                Select to compile for the SmartButton production hardware

        config HOLIDAYTREE_HARDWARE_DEVELOPMENT
            bool "Development board"
            help
                Select to compile for development boards. This option allows JTAG debugging
    endchoice

    config  HOLIDAYTREE_DETAILLED_I2S_DATA_PROCESSING_LOG
        bool "Log I2S data processing"
        default HOLIDAYTREE_HARDWARE_DEVELOPMENT = y
        help
            Emit detailed logging about I2S data processing including ring buffer depth, rate of A2DP data ...

    config HOLIDAYTREE_BR_EDR_DEVICE_NAME_STR
        string "Bluetooth Device Name"
        default "Holiday Tree"
        help
            Name of Bluetooth device

    config HOLIDAYTREE_BR_EDR_LEGACY_PAIRING_REQUIRE_STATIC_PIN
        bool "Require fixed pin during pairing"
        default y
        help
            If enabled, the correct pin must be presented during pairing. If disabled, 
            any devices can pair without a pin

    config HOLIDAYTREE_BR_EDR_STATIC_PIN_STR
        string "Pin"
        default "1234"
        depends on HOLIDAYTREE_BR_EDR_LEGACY_PAIRING_REQUIRE_STATIC_PIN
        help
            Static pin to request when pairing
            
    config  HOLIDAYTREE_BT_GAP_LOG
        bool "Log Bluetooth GAP processing"
        default HOLIDAYTREE_HARDWARE_DEVELOPMENT = n
        help
            Emit detailed logging about Bluetooth GAP processing

    config  HOLIDAYTREE_BT_A2DP_LOG
        bool "Log Bluetooth A2DP processing"
        default HOLIDAYTREE_HARDWARE_DEVELOPMENT = n
        help
            Emit detailed logging about Bluetooth A2DP processing

    config  HOLIDAYTREE_BT_AVR_CT_LOG
        bool "Log Bluetooth AVR Controller processing"
        default HOLIDAYTREE_HARDWARE_DEVELOPMENT = n
        help
            Emit detailed logging about Bluetooth AVR Controller processing
            
endmenu
```

## sdkconfig.defaults
```kconfig
# -----------------------------------------------------------------------------------
# Copyright 2024, Gilles Zunino
# -----------------------------------------------------------------------------------

# Raise IPC task stack size to allow gpio_install_isr_service() to operate properly
CONFIG_IPC_TASK_STACK_SIZE=1280

# Enable Classic Bluetooth (BR/EDR), turn off Bluetooth Low Energy (BLE)
CONFIG_BT_ENABLED=y
CONFIG_BT_BLE_ENABLED=n
CONFIG_BT_CLASSIC_ENABLED=y

# Choose BlueDroid over NimBLE
CONFIG_BT_BLUEDROID_ENABLED=y

# Configure Bluetooth Dual Mode (BTDM) to support only Classic Bluetooth
CONFIG_BTDM_CTRL_MODE_BR_EDR_ONLY=y
CONFIG_BTDM_CTRL_MODE_BLE_ONLY=n
CONFIG_BTDM_CTRL_MODE_BTDM=n

# Enable Bluetooth Advanced Audio Distribution Profile (A2DP)
CONFIG_BT_A2DP_ENABLE=y
```
